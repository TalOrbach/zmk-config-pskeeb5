## config/boards/shields/pskeeb5/Kconfig.defconfig
```kconfig
# Central Side Configuration
if SHIELD_PSKEEB5_RIGHT
config ZMK_KEYBOARD_NAME
    default "pskeeb5"
config ZMK_SPLIT_ROLE_CENTRAL
    default y
endif # RIGHT

if SHIELD_PSKEEB5_LEFT
if ZMK_DISPLAY
config I2C
    default y
config SSD1306
    default y
endif
if LVGL
config LV_Z_VDB_SIZE
    default 64
config LV_DPI_DEF
    default 148
config LV_Z_BITS_PER_PIXEL
    default 1
choice LV_COLOR_DEPTH
    default LV_COLOR_DEPTH_1
endchoice
endif
config ZMK_USB
    default n
endif # LEFT

config ZMK_SPLIT
    default y

# Define sync symbols that klesh fork provides
config ZMK_SPLIT_PERIPHERAL_SYNC_STATE
    bool "Peripheral sync state"
    default y

config ZMK_SYNC_OUTPUT
    bool "Sync output"
    default y

config ZMK_SYNC_LAYER
    bool "Sync layer"
    default y

config ZMK_SYNC_BATTERY
    bool "Sync battery"
    default y
```

## config/west.yml
```yaml
manifest:
  remotes:
    - name: klesh
      url-base: https://github.com/klesh
    - name: talor
      url-base: https://github.com/TalOrbach
  projects:
    - name: zmk
      remote: klesh
      revision: main
      import:
        file: app/west.yml
        name-blocklist:
          - zmk-ydxc02-driver
          - kb_zmk_ps2_mouse_trackpoint_driver
    - name: kb_zmk_ps2_mouse_trackpoint_driver
      remote: talor
      revision: codex/scroll-layer-active
  self:
    path: config
```
